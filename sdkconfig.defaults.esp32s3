## sdkconfig.defaults.esp32s3
```kconfig
CONFIG_ESPTOOLPY_FLASHSIZE_16MB=y
CONFIG_ESPTOOLPY_FLASHMODE_QIO=y

CONFIG_ESP_DEFAULT_CPU_FREQ_MHZ_240=y

CONFIG_SPIRAM=y
CONFIG_SPIRAM_MODE_OCT=y
CONFIG_SPIRAM_SPEED_80M=y
CONFIG_SPIRAM_MALLOC_ALWAYSINTERNAL=512
CONFIG_SPIRAM_MALLOC_RESERVE_INTERNAL=65536
CONFIG_SPIRAM_MEMTEST=n
CONFIG_MBEDTLS_EXTERNAL_MEM_ALLOC=y

CONFIG_ESP_WIFI_STATIC_RX_BUFFER_NUM=3
CONFIG_ESP_WIFI_DYNAMIC_RX_BUFFER_NUM=6
CONFIG_ESP_WIFI_RX_BA_WIN=3
CONFIG_LWIP_TCPIP_RECVMBOX_SIZE=16
CONFIG_MBEDTLS_DYNAMIC_FREE_CONFIG_DATA=y

CONFIG_ESP32S3_INSTRUCTION_CACHE_32KB=y
CONFIG_ESP32S3_DATA_CACHE_LINE_64B=y

# ==============================================
# MeiLin Wake Word Configuration
# ==============================================
# Use Custom Wake Word with Multinet (English supported)
CONFIG_USE_CUSTOM_WAKE_WORD=y
CONFIG_CUSTOM_WAKE_WORD="hi mei lin"
CONFIG_CUSTOM_WAKE_WORD_DISPLAY="Hi MeiLin"
CONFIG_CUSTOM_WAKE_WORD_THRESHOLD=15

# Enable AFE for better audio processing
CONFIG_USE_AFE_WAKE_WORD=n
CONFIG_USE_AUDIO_PROCESSOR=y
CONFIG_SEND_WAKE_WORD_DATA=y

# Language setting - English
CONFIG_LANGUAGE_EN_US=y

CONFIG_ESP_SYSTEM_EVENT_TASK_STACK_SIZE=4096

# LVGL Graphics
CONFIG_LV_USE_SNAPSHOT=y
```
